## drivers/video/msm/Kconfig
```kconfig
if FB_MSM
config FB_MSM_MDSS_COMMON
	bool

choice
	prompt "MDP HW version"
	default FB_MSM_MDP

config FB_MSM_MDP
	bool "MDP HW"
	---help---
	  Support for MSM MDP HW revision 2.2
	  Say Y here if this is msm7201 variant platform.

config FB_MSM_MDSS
	bool "MDSS HW"
	select SYNC
	select SW_SYNC
	select FB_MSM_MDSS_COMMON
	---help---
	The Mobile Display Sub System (MDSS) driver supports devices which
	contain MDSS hardware block.

	The MDSS driver implements frame buffer interface to provide access to
	the display hardware and provide a way for users to display graphics
	on connected display panels.
```
